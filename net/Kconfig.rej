## net/Kconfig.rej
```kconfig
--- net/Kconfig
+++ net/Kconfig
@@ -233,6 +233,7 @@ source "net/mpls/Kconfig"
 source "net/hsr/Kconfig"
 source "net/switchdev/Kconfig"
 source "net/l3mdev/Kconfig"
+source "net/qrtr/Kconfig"
 
 config RPS
 	bool
```
